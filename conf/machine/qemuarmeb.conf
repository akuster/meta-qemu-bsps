## conf/machine/qemuarmeb.conf
```bitbake
#@TYPE: Machine
#@NAME: arm_versatile_926ejs
#@DESCRIPTION: armeb

require conf/machine/include/qemu.inc
DEFAULTTUNE ?= "armv7ab"
require conf/machine/include/arm/arch-armv7a.inc

KERNEL_IMAGETYPE = "zImage"

SERIAL_CONSOLE = "115200 ttyAMA0"
```

## conf/machine/qemuppc64.conf
```bitbake
#@TYPE: Machine
#@NAME: qemu PPC 64 Emulator setup
#@DESCRIPTION: Machine configuration for running an PPC system under qemu emulation

require conf/machine/include/qemu.inc
DEFAULTTUNE ?= "ppc64p6"
require conf/machine/include/tune-power6.inc

#prelink broken on ppc64
USER_CLASSES_remove = "image-prelink"
IMAGE_PREPROCESS_COMMAND_remove = "prelink_image;"

KERNEL_IMAGETYPE = "vmlinux"

IMAGE_FSTYPES = "ext2 ext3"
SERIAL_CONSOLE ?= "ttyS0"
```
